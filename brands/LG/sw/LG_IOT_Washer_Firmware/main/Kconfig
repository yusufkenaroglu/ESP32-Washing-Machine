## brands/LG/sw/LG_IOT_Washer_Firmware/main/Kconfig
```kconfig
menu "LG Washer - Main Component"

config WIFI_ENABLED
    bool "Enable WiFi support"
    default y
    help
      Enable the WiFi subsystem, HTTP server and FreeHome integration.

config BALANCE_DETECTION
    bool "Enable balance detection (MPU6050)"
    default n
    help
      When enabled, the MPU6050 sensor will be initialized and used to
      detect out of balance loads during spin cycles.

config SIMULATOR_MODE
    bool "Enable simulator mode"
    default n
    help
      Build and run in simulator mode. When enabled, hardware access is
      routed to the simulator backend.

endmenu
```

## brands/LG/sw/LG_IOT_Washer_Firmware/sdkconfig.defaults
```kconfig
# sdkconfig.defaults - Default SDK configuration
# Enable ULP
CONFIG_ULP_COPROC_ENABLED=y
CONFIG_ULP_COPROC_TYPE_FSM=y
CONFIG_ULP_COPROC_RESERVE_MEM=2048
# Set log level defaults
# Use INFO as the default runtime log level; keep DEBUG available
CONFIG_LOG_DEFAULT_LEVEL_INFO=y
CONFIG_LOG_DEFAULT_LEVEL=3
CONFIG_BOOTLOADER_SKIP_VALIDATE_IN_DEEP_SLEEP=y

# LG Washing Machine Controller

# FreeRTOS configuration
CONFIG_FREERTOS_HZ=1000
CONFIG_FREERTOS_ENABLE_BACKWARD_COMPATIBILITY=y

# Watchdog configuration - disable for development
CONFIG_ESP_TASK_WDT_CHECK_IDLE_TASK_CPU0=n
CONFIG_ESP_TASK_WDT_CHECK_IDLE_TASK_CPU1=n

# WiFi configuration
CONFIG_ESP_WIFI_STATIC_RX_BUFFER_NUM=10
CONFIG_ESP_WIFI_DYNAMIC_RX_BUFFER_NUM=32
CONFIG_ESP_WIFI_AMPDU_TX_ENABLED=y
CONFIG_ESP_WIFI_AMPDU_RX_ENABLED=y

# HTTP Server
CONFIG_HTTPD_MAX_REQ_HDR_LEN=1024
CONFIG_HTTPD_MAX_URI_LEN=512

# OTA configuration
CONFIG_BOOTLOADER_APP_ROLLBACK_ENABLE=y

# UART buffer size
CONFIG_UART_ISR_IN_IRAM=y

# SPI configuration for display
CONFIG_SPI_MASTER_ISR_IN_IRAM=y

# DAC for sound
CONFIG_DAC_DMA_AUTO_16BIT_ALIGN=y

# Partition table - use factory + OTA partitions
#CONFIG_PARTITION_TABLE_TWO_OTA=y

# Logging
# Default to INFO, allow DEBUG as maximum level
CONFIG_LOG_MAXIMUM_LEVEL_DEBUG=y

# CPU frequency
CONFIG_ESP_DEFAULT_CPU_FREQ_MHZ_240=y

# Flash size
CONFIG_ESPTOOLPY_FLASHSIZE_4MB=y

# Console Baud Rate
CONFIG_ESP_CONSOLE_UART_BAUDRATE=1000000
```
